## Kconfig
```kconfig
# SPDX-License-Identifier: GPL-2.0-only
# ################################################################
# Copyright (C) 2025, LunarKernel Project.
# All rights reserved.
#
# This software is licensed under the terms of the GNU General Public
# License version 2, as published by the Free Software Foundation, and
# may be copied, distributed, and modified under those terms.
#
# This program is distributed in the hope that it will be useful,
# but WITHOUT ANY WARRANTY; without even the implied warranty of
# MERCHANTABILITY or FITNESS FOR A PARTICULAR PURPOSE. See the
# GNU General Public License for more details.
# ################################################################

config LUNAR_SCHED_EXT
	tristate "LunarKernel Scheduling Extention"
	default m
	help
	  Enable LunarKernel Scheduling Extention to enhance device performance.
```
